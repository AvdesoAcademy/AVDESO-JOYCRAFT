#include <Wire.h>
#include <Adafruit_GFX.h>
#include <Adafruit_SSD1306.h>

#define SCREEN_WIDTH 128
#define SCREEN_HEIGHT 64

#define OLED_ADDR 0x3C  

Adafruit_SSD1306 display(SCREEN_WIDTH, SCREEN_HEIGHT, &Wire, -1);

const unsigned char avdeso2[] PROGMEM = {
	0xff, 0xff, 0xff, 0xff, 0xff, 0xff, 0xff, 0xff, 0xff, 0xff, 0xff, 0xff, 0xff, 0xff, 0xff, 0xff, 
	0xff, 0xff, 0xff, 0xff, 0xff, 0xff, 0xff, 0xff, 0xff, 0xff, 0xff, 0xff, 0xff, 0xff, 0xff, 0xff, 
	0xff, 0xff, 0xff, 0xff, 0xff, 0xe3, 0xff, 0xff, 0xff, 0xff, 0xff, 0xff, 0xff, 0xff, 0xff, 0xff, 
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	0xff, 0xff, 0xff, 0xff, 0xff, 0xff, 0xff, 0xff, 0xff, 0xff, 0xff, 0xff, 0xff, 0xff, 0xff, 0xff
};
const unsigned char avdeso1[] PROGMEM = {
	0xff, 0xff, 0xff, 0xff, 0xff, 0xff, 0xff, 0xff, 0xff, 0xff, 0xff, 0xff, 0xff, 0xff, 0xff, 0xff, 
	0xff, 0xff, 0xff, 0xff, 0xff, 0xff, 0xff, 0xff, 0xff, 0xff, 0xff, 0xff, 0xff, 0xff, 0xff, 0xff, 
	0xff, 0xff, 0xff, 0xff, 0xff, 0xe3, 0xff, 0xff, 0xff, 0xff, 0xff, 0xff, 0xff, 0xff, 0xff, 0xff, 
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	0xff, 0xff, 0xff, 0xff, 0xff, 0xff, 0xff, 0xff, 0xff, 0xff, 0xff, 0xff, 0xff, 0xff, 0xff, 0xff
};
const unsigned char snake1 [] PROGMEM = {
	0x00, 0x00, 0x00, 0x00, 0x00, 0x00, 0x00, 0x00, 0x00, 0x00, 0x00, 0x00, 0x00, 0x03, 0x00, 0x00, 
	0x00, 0x00, 0x00, 0x00, 0x00, 0x00, 0x00, 0x00, 0x00, 0x0f, 0xe0, 0x00, 0x00, 0x00, 0x02, 0x00, 
	0xf0, 0x00, 0x01, 0xc0, 0x00, 0xbf, 0xe0, 0x00, 0x03, 0xe0, 0x1e, 0x01, 0xf0, 0x0e, 0x3f, 0xc0, 
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	0xff, 0xff, 0xff, 0xff, 0xff, 0xff, 0xff, 0xfe
};
const unsigned char bird1 [] PROGMEM = {
	0xff, 0xff, 0xff, 0xff, 0xff, 0xff, 0xff, 0xcf, 0xff, 0xe7, 0xff, 0xfe, 0xc0, 0x00, 0x60, 0x70, 
	0x00, 0x30, 0x00, 0x7c, 0x00, 0x1c, 0x06, 0x02, 0xc0, 0x00, 0x60, 0x70, 0x00, 0x30, 0x00, 0x3c, 
	0x00, 0x1c, 0x06, 0x02, 0xc0, 0x00, 0x60, 0x70, 0x00, 0x30, 0x00, 0x1c, 0x00, 0x0c, 0x06, 0x02, 
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	0xff, 0xff, 0xff, 0xff, 0xff, 0xff, 0xff, 0xfe
};
const unsigned char space1 [] PROGMEM = {
	0x00, 0x00, 0x00, 0x00, 0x00, 0x00, 0x00, 0x00, 0x00, 0x00, 0x00, 0x00, 0x00, 0x00, 0x00, 0x00, 
	0x00, 0x00, 0x00, 0x00, 0x00, 0x00, 0x00, 0x00, 0x00, 0x00, 0x00, 0x00, 0x00, 0x00, 0x00, 0x00, 
	0x00, 0x00, 0x00, 0x00, 0x00, 0x00, 0x1f, 0x87, 0xfc, 0x1f, 0x81, 0xfc, 0x3f, 0xe0, 0x00, 0x00, 
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	0x00, 0x00, 0x00, 0x00, 0xff, 0xff, 0xff, 0xff, 0xff, 0xff, 0xff, 0xff, 0xff, 0xff, 0xff, 0xc0
};
const unsigned char set1 [] PROGMEM = {
	0x00, 0x00, 0x00, 0x00, 0x00, 0x00, 0x00, 0x00, 0x00, 0x00, 0x00, 0x00, 0x00, 0x00, 0x00, 0x00, 
	0x03, 0xfe, 0x00, 0x00, 0x00, 0x00, 0x00, 0x03, 0xfe, 0x00, 0x00, 0x00, 0x00, 0x00, 0x03, 0x02, 
	0x00, 0x00, 0x00, 0x00, 0x00, 0x03, 0x03, 0x00, 0x00, 0x00, 0x00, 0x07, 0x03, 0x03, 0x07, 0x00, 
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	0xff, 0xff, 0xff, 0xff, 0xff, 0xff, 0xc0, 0xff, 0xff, 0xff, 0xff, 0xff, 0xff, 0xc0
};

const unsigned char Alien3[] PROGMEM {
  0b00000000,
  0b00000000,
  0b00111100,
  0b01111110,
  0b01011010,
  0b01111110,
  0b10100101,
  0b00000000
};
const unsigned char Alien2[] PROGMEM {
  0b00000000,
  0b00000000,
  0b00000000,
  0b00011000,
  0b00100100,
  0b01011010,
  0b00000000,
  0b00000000
};
const unsigned char Alien1[] PROGMEM {
  0b00000000,
  0b01111110,
  0b01100110,
  0b01100110,
  0b01111110,
  0b01100110,
  0b01111110,
  0b00000000
};
int X=32;
int Y=32;
float dX=0;
float dY=0;
int dir=0;
int sinTable[4] = {0,-1,0,1};
int cosTable[4] = {1,0,-1,0};
int frame=0;
int length=1;
int head=0;
uint8_t moves[64];
int appleX=12;
int appleY=4;
bool game=1;
bool win;
bool hold=1;
bool run=0;
int menuL=0;
bool menuS=0;
int score=0;
int respawnDelay;
bool death=0;
int counter;
int counted;
int difficulty;
bool delaysound;
bool sound=1;

void setup() {
  Serial.begin(9600);
  randomSeed(analogRead(A0));
  pinMode(2,INPUT_PULLUP);
  pinMode(9,OUTPUT);
  gamebegin();
  

  if (!display.begin(SSD1306_SWITCHCAPVCC, OLED_ADDR)) {
    Serial.println(F("SSD1306 allocation failed"));
    while (true);
  }
  if (0==0) {
  display.clearDisplay();
  display.drawBitmap(0,0,avdeso1,128,64,SSD1306_WHITE);
  display.display();
  tone(9,100*sound,200);delay(300);
  tone(9,200*sound,50);delay(150);
  tone(9,400*sound,50);delay(50);
  display.clearDisplay();
  display.drawBitmap(0,0,avdeso2,128,64,SSD1306_WHITE);
  display.display();
  tone(9,600*sound,500);delay(2000);
  }
}

void loop() {
  bool push=digitalRead(2);
  int vert=(-analogRead(A3))+512;
  int horz=analogRead(A2)-512;
  frame=frame+1;
  if (run) {
  if (game) {
    if (menuL==0) {
      snake(vert,horz,push);
    }
    else if(menuL==1) {
      flappyBird(vert,horz,push);
    }
    else if(menuL==2) {
      spaceInvaders(vert,horz,push);
    }
    else if(menuL==3) {
      settings(vert,horz,push);
    }
  }
    else {
      respawnDelay=respawnDelay-1;
      if (win) {
        display.clearDisplay();
        display.setTextSize(2);
        display.setTextColor(SSD1306_WHITE);
        display.setCursor(12, 10);
        display.print("Win");
        display.setTextSize(1);
        display.setCursor(12, 30);
        display.print("Score:");
        display.print(score);
        display.setCursor(12, 40);
        if (!menuS) {display.print("> ");}
        display.print("return");
        display.setCursor(12, 50);
        if (menuS) {display.print("> ");}
        display.print("game menu");
        display.display();
        if (abs(vert)>20 && frame>10) {
          if (vert>0 && menuS || vert<0 && !menuS ){
            menuS=!menuS;
            frame=0;
            tone(9,50*sound,50);
          }
        }else {frame=100;}
        if (!push&&respawnDelay<=-10) {
          if(!menuS) {gamebegin();tone(9,200*sound,50);}
          else {
            run=0;
            hold=1;
            tone(9,200*sound,50);
          }
        }
        
      }else {
        display.clearDisplay();
        display.setTextSize(2);
        display.setTextColor(SSD1306_WHITE);
        display.setCursor(12, 10);
        display.print("GAME OVER");
        display.setTextSize(1);
        display.setCursor(12, 30);
        display.print("Score:");
        display.print(score);
        display.setCursor(12, 40);
        if (!menuS) {display.print("> ");}
        display.print("return");
        display.setCursor(12, 50);
        if (menuS) {display.print("> ");}
        display.print("game menu");
        
        display.display();
        if (abs(vert)>20 && frame>10) {
          if (vert>0 && menuS || vert<0 && !menuS ){
            menuS=!menuS;
            frame=0;
            tone(9,50*sound,50);
          }
        }else {frame=100;}
        if (!push&&respawnDelay<-10) {
          if(!menuS) {gamebegin();tone(9,200*sound,50);}
          else {
            run=0;
            hold=1;
            tone(9,200*sound,50);
          }
        }
      }
        
    }
    }else {
      respawnDelay=0;
      display.clearDisplay();
      if (menuL==0) {
        display.drawBitmap(16,17,snake1,95,29,SSD1306_WHITE);
      }
      if (menuL==1) {
        display.drawBitmap(16,12,bird1,95,45,SSD1306_WHITE);
      }
      if (menuL==2) {
        display.drawBitmap(19,12,space1,90,39,SSD1306_WHITE);
      }
      if (menuL==3) {
        display.drawBitmap(39,8,set1,50,45,SSD1306_WHITE);
      }
        if (abs(vert)>20 && frame>10) {
          if (vert>0){
            menuL=menuL-1;
            frame=0;
            tone(9,50*sound,50);
            if (menuL<0) {
              menuL=3;
            }
          }
          if (vert<0){
            menuL=menuL+1;
            frame=0;
            tone(9,50*sound,50);
            if (menuL>3) {
              menuL=0;
            }
          }
        }
        if (!push&&hold==0){
            gamebegin();
            run=1;
            tone(9,200*sound,50);
          }
        if (push) {
          hold=0;
        }
      display.display();
    }
}
    
  

void apple() {
  bool valid=0;
  while (!valid) {
    valid=1;
    appleX=random(0,15);
    appleY=random(0,7);
    int x=X;
    int y=Y;
    int d=0;
      for (int i=0;i<length;i++) {
        if (x==appleX*8 && y==appleY*8) {
          valid=0;
        }
        d=getMove((head-i+255)%256);
        x=x-cosTable[d]*8;
        y=y-sinTable[d]*8;
      }
    }
  }
void setMove(int index, uint8_t dir) {
  int byteIndex = index >> 2;      // index / 4
  int shift = (index & 3) * 2;     // (index % 4) * 2

  moves[byteIndex] &= ~(0b11 << shift);   // clear old
  moves[byteIndex] |= (dir & 0b11) << shift;
  }
uint8_t getMove(int index) {
  int byteIndex = index >> 2;
  int shift = (index & 3) * 2;

  return (moves[byteIndex] >> shift) & 0b11;
  }

void gamebegin () {
  randomSeed(analogRead(A0));
  if (menuL==0) {
    X=32;
    Y=32;
    dir=0;
    length=1;
    appleX=12;
    appleY=4;
  }
  else if (menuL==1) {
    X=32;
    Y=32;
    dir=0;
    dY=3;
    length=-1;
    for (int i=0;i<256;i++) {
      setMove(i,random(0,4));
    }
  }
  else if (menuL==2) {
    X=32;
    appleX=-12;
    appleY=4;
    length=0;
    for (int i=0;i<256;i++) {
      setMove(i,3);
    }
    counter=0;
    difficulty=0;
  }
    frame=0;
    head=0;
    hold=1;
    game=1;
    respawnDelay=0;
    death=0;
    score=0;
  }

void snake (int vert,int horz,bool push) {
  int tdir=-1;
  if (abs(vert)>20 || abs(horz)>20) {
    if (abs(vert)>abs(horz)) {
      if (vert>0) {
        tdir=1;
      } else {
        tdir=3;
      }
    } else {
      if (horz>0) {
        tdir=2;
      } else {
        tdir=0;
      }
    }
  }
    if( (( (tdir + 1) % 4 == dir ) || ( (dir + 1) % 4 == tdir ))&&hold&&tdir!=-1) {
      dir=tdir;
      tone(9,(dir*10+50)*sound,50);
      hold=0;
    }
  if (frame>=600) {
    if (X<0 || X>=128 || Y<0 || Y>=64) {
      gameover(0);
      score=length;
    }
    setMove(head, dir);
    head = (head + 1) % 256;
    X=X+cosTable[dir]*8;
    Y=Y+sinTable[dir]*8;
    if (appleX*8==X && appleY*8==Y) {
      apple();
      length=length +1;
      tone(9,200*sound,50);
      if (length>=128) {
        gameover(1);
        score=length;
      }
    }
    

    display.clearDisplay();
    
    int x=X;
    int y=Y;
    int d=0;
    for (int i=0;i<length;i++) {
      if (x==X && y==Y && i>0) {
        gameover(0);
        score=length;
      }
      display.fillRect(x, y, 8, 8, SSD1306_WHITE);
      d=getMove((head-i+255)%256);
      x=x-cosTable[d]*8;
      y=y-sinTable[d]*8;
    }
    display.drawRect(appleX*8, appleY*8, 8, 8, SSD1306_WHITE);
    display.setTextSize(1);
    display.setTextColor(SSD1306_WHITE);
    display.setCursor(10,56);
    display.display();
    frame=0;
    hold=1;
    }
  }
void flappyBird(int vert,int horz,bool push) {
  if (dY < 2) {
    delaysound=1;
  }
  if(!push&&hold&&!death) {
    dY=3;
    hold=0;
    if (delaysound) {
      tone(9,50*sound,50);
    }
    delaysound=0;
  }
  if (frame==100) {
    head=head+1;
    if (head%148==0) {
      length=length+1;
    }
    dY=dY-0.5;
    Y=Y-dY;
    display.clearDisplay();
      display.fillCircle(32, Y, 5, SSD1306_WHITE);
      display.fillCircle(38, Y, 1, SSD1306_WHITE);
      if (death) {
        display.drawLine(30,Y-2,34,Y+2,SSD1306_BLACK);
        display.drawLine(34,Y-2,30,Y+2,SSD1306_BLACK);
      }
      else {
        display.fillCircle(33, Y, 2, SSD1306_BLACK);
      }
      
    display.setTextSize(1);
    display.setTextColor(SSD1306_WHITE);
    display.setCursor(0,50);
    if ((head/37)>2) {
    if (((head%37>22 && head%37<37) || head%37<5) && head > 74) {
      if(((Y-2)<(((getMove((head/37)-2))*4)+10) || (Y+2)>(((getMove((head/37)-2))*4)+50))&& !death) {
        death=1;
        dY=3;
        tone(9,400*sound,200);
        
      }
    }
    }
      display.fillRect(138-((head    )%148),(getMove((head      /148)*4  )*4)-50,10,60,SSD1306_WHITE);
      display.fillRect(138-((head-37 )%148),(getMove(((head-37 )/148)*4+1)*4)-50,10,60,SSD1306_WHITE);
      display.fillRect(138-((head-74 )%148),(getMove(((head-74 )/148)*4+2)*4)-50,10,60,SSD1306_WHITE);
      display.fillRect(138-((head-111)%148),(getMove(((head-111)/148)*4+3)*4)-50,10,60,SSD1306_WHITE);
      display.fillRect(138-((head    )%148),(getMove((head      /148)*4  )*4)+50,10,60,SSD1306_WHITE);
      display.fillRect(138-((head-37 )%148),(getMove(((head-37 )/148)*4+1)*4)+50,10,60,SSD1306_WHITE);
      display.fillRect(138-((head-74 )%148),(getMove(((head-74 )/148)*4+2)*4)+50,10,60,SSD1306_WHITE);
      display.fillRect(138-((head-111)%148),(getMove(((head-111)/148)*4+3)*4)+50,10,60,SSD1306_WHITE);

    display.display();
    hold=1;
    frame=0;
    }
  if (Y<-12 && !death) {
    death=1;
    dY=3;
    tone(9,400*sound,200);
  }
  if (Y>76) {
    gameover(0);
    if ((head/37)>2) {
      score=(head/37)-2;
    }

  }
  if ((head/37)>200) {
    score=200;
    gameover(1);
  }
  }
void spaceInvaders(int vert,int horz,bool push) {


  if (!push&&appleY==56) {
    appleY=55;
    appleX=X;
    tone(9,50*sound,50);

  }
  if (score>35) {
    gameover(1);
  }
  
  if (frame==100) {
  head=head+1;
  if (appleY<56) {
    appleY=appleY-5;
  }
  if (appleY<-3) {
    appleY=56;
    appleX=-5;
  }

  if (abs(horz)>20 && hold) {
    if (horz<0) {
      X=X+2;
      hold=0;
    }else {
      X=X-2;
      hold=0;
    }
    }
    if (X>138) {
      X=-10;
    }
    if (X<-10) {
      X=138;
    }
      display.clearDisplay();
      for (int j=0;j<6;j++) {
        for (int i=0;i<6;i++) {
          if (getMove(i+j*6)>0) {
            if (getMove(i+j*6)==3) {
              display.drawBitmap((((head+i*15)%136)-8),(((head+i*15)/136)*5-j*12)-1,Alien3,8,8,SSD1306_WHITE);
            }
            if (getMove(i+j*6)==2) {
              display.drawBitmap((((head+i*15)%136)-8),(((head+i*15)/136)*5-j*12)-1,Alien2,8,8,SSD1306_WHITE);
            }
            if (getMove(i+j*6)==1) {
              if (counter==0) {
                counted=i+j*6;
              }
              if (counted==i+j*6) {
                counter=counter+1;
                if (counter<20) {
                display.drawBitmap((((head-counter+i*15)%136)-8),(((head-counter+i*15)/136)*5-j*12)-1,Alien1,8,8,SSD1306_WHITE);
              }else {
                if (counter > 25+difficulty) {
                  setMove(i+j*6,0);
                  counter=0;
                  score=score+1;
                  difficulty=difficulty+1;
                }
                else {
                  display.drawRect((((head-counter+i*15)%136)-8)-(counter-20),0,1+(counter-20)*2,300,SSD1306_WHITE);
                  tone(9,counter*4*sound,50);
                if (X+5>(((head+i*15)%136)-8)-counter-(counter-20) && X-5 < (((head+i*15)%136)-8)-counter+(counter-20)) {gameover(0);}
              }
              }
              }
              else{
                display.drawBitmap((((head+i*15)%136)-8),(((head-counter+i*15)/136)*5-j*12)-1,Alien1,8,8,SSD1306_WHITE);
              }
            }
            if (appleX>(((head+i*15)%136)-8) && appleX <((head+i*15)%136) && appleY > (((head+i*15)/136)*5-j*12+2)-1 && appleY < (((head+i*15)/136)*5-j*12+2)+7 && getMove(i+j*6)!=1) {
              setMove(i+j*6,getMove(i+j*6)-1);
              appleY=56;
              appleX=-5;
              tone(9,200*sound,50);
            }
            if ((((head-counter+i*15)/136)*5-j*12)-1>40) {
              gameover(0) ;
            }
          }
        }
      }
      display.fillRoundRect(X-5,56,10,5,5,SSD1306_WHITE);
      display.fillRect(X-1,53,2,5,SSD1306_WHITE);
      display.drawLine(appleX,appleY,appleX,appleY+3,SSD1306_WHITE);
      display.setCursor(0,56);
      display.setTextSize(1);
      display.setTextColor(SSD1306_WHITE);
      display.display();
      frame=0;
      hold=1;
  }
  }
void gameover (bool w) {
  game=0;
  win=w;
  menuS=0;
  if (sound){
  if (w==0) {
  tone(9,500,100);delay(150);
  tone(9,400,100);delay(150);
  tone(9,300,100);delay(150);
  tone(9,200,100);delay(150);
  tone(9,100,500);delay(500);
  }else{
  tone(9,100,100);delay(150);
  tone(9,200,100);delay(150);
  tone(9,300,100);delay(150);
  tone(9,400,100);delay(150);
  tone(9,500,500);delay(500);
  }
  }
}
void settings (int vert,int horz,bool push) {
        respawnDelay=respawnDelay-1;
        display.clearDisplay();
        display.setTextSize(2);
        display.setTextColor(SSD1306_WHITE);
        display.setCursor(12, 10);
        display.print("SETTINGS");
        display.setCursor(0, 40);
        display.setTextSize(1);
        display.print("sound?:");
        display.setCursor(50, 40);
        if (!sound) {display.print("> ");}
        display.print("NO");
        display.setCursor(90, 40);
        if (sound) {display.print("> ");}
        display.print("YES");
        
        display.display();
        if (abs(horz)>20 && frame>10) {
          if (horz>0 && sound || horz<0 && !sound ){
            sound=!sound;
            frame=0;
            tone(9,50*sound,50);
          }
        }else {frame=100;}
        if (!push&&respawnDelay<-10) {
          run=0;
          hold=1;
        }

}